-- WARNING: Do NOT edit the input and output ports in this file in a text
-- editor if you plan to continue editing the block that represents it in
-- the Block Editor! File corruption is VERY likely to occur.

-- Copyright (C) 1991-2008 Altera Corporation
-- Your use of Altera Corporation's design tools, logic functions 
-- and other software and tools, and its AMPP partner logic 
-- functions, and any output files from any of the foregoing 
-- (including device programming or simulation files), and any 
-- associated documentation or information are expressly subject 
-- to the terms and conditions of the Altera Program License 
-- Subscription Agreement, Altera MegaCore Function License 
-- Agreement, or other applicable license agreement, including, 
-- without limitation, that your use is for the sole purpose of 
-- programming logic devices manufactured by Altera and sold by 
-- Altera or its authorized distributors.  Please refer to the 
-- applicable agreement for further details.


-- Generated by Quartus II Version 8.1 (Build Build 163 10/28/2008)
-- Created on Thu Jul 28 11:46:34 2016

FUNCTION LOOP_Gain_Controller (Bus_Clock, DataBusStrobe, AddrBus_In[7..0], DataBus_In[(16) - (1)..0], Select, Direct_In, Reset, PWM_Clock, ADC_goes_to_HOLD_Mode, Operations_can_be_started, Operations_must_be_stopped)
	RETURNS (DataBusOut[(16) - (1)..0], PWM_of_Drive_Switch, PWM_of_Sync_Switch, PWM_Cycle, Gamma_OVL, Current_OVL, Adjust_Dir, Error, Power_Enable_Flag_VP, PWM_Value_VP[15..0]);
