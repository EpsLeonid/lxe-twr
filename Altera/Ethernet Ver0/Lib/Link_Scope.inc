-- WARNING: Do NOT edit the input and output ports in this file in a text
-- editor if you plan to continue editing the block that represents it in
-- the Block Editor! File corruption is VERY likely to occur.

-- Copyright (C) 1991-2008 Altera Corporation
-- Your use of Altera Corporation's design tools, logic functions 
-- and other software and tools, and its AMPP partner logic 
-- functions, and any output files from any of the foregoing 
-- (including device programming or simulation files), and any 
-- associated documentation or information are expressly subject 
-- to the terms and conditions of the Altera Program License 
-- Subscription Agreement, Altera MegaCore Function License 
-- Agreement, or other applicable license agreement, including, 
-- without limitation, that your use is for the sole purpose of 
-- programming logic devices manufactured by Altera and sold by 
-- Altera or its authorized distributors.  Please refer to the 
-- applicable agreement for further details.


-- Generated by Quartus II Version 8.1 (Build Build 163 10/28/2008)
-- Created on Thu Feb 17 12:11:05 2011

FUNCTION Link_Scope (Data_Line_h, Data_Line_l, Reference_Clock_h, Reference_Clock_l, Sampling_Enable[3..0], Cavity_Clock, Event_in_Progress, BC_Adjust_Error, BusClock, DataBus_In[15..0], DataBusStrobe, Select, DirectIn, AddrBus_In[7..0])
	RETURNS (Bunch_Crossing_Selected, DataBusOut[15..0]);
