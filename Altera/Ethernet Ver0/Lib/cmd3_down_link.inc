-- WARNING: Do NOT edit the input and output ports in this file in a text
-- editor if you plan to continue editing the block that represents it in
-- the Block Editor! File corruption is VERY likely to occur.

-- Copyright (C) 1991-2005 Altera Corporation
-- Any  megafunction  design,  and related netlist (encrypted  or  decrypted),
-- support information,  device programming or simulation file,  and any other
-- associated  documentation or information  provided by  Altera  or a partner
-- under  Altera's   Megafunction   Partnership   Program  may  be  used  only
-- to program  PLD  devices (but not masked  PLD  devices) from  Altera.   Any
-- other  use  of such  megafunction  design,  netlist,  support  information,
-- device programming or simulation file,  or any other  related documentation
-- or information  is prohibited  for  any  other purpose,  including, but not
-- limited to  modification,  reverse engineering,  de-compiling, or use  with
-- any other  silicon devices,  unless such use is  explicitly  licensed under
-- a separate agreement with  Altera  or a megafunction partner.  Title to the
-- intellectual property,  including patents,  copyrights,  trademarks,  trade
-- secrets,  or maskworks,  embodied in any such megafunction design, netlist,
-- support  information,  device programming or simulation file,  or any other
-- related documentation or information provided by  Altera  or a megafunction
-- partner, remains with Altera, the megafunction partner, or their respective
-- licensors. No other licenses, including any licenses needed under any third
-- party's intellectual property, are provided herein.


-- Generated by Quartus II Version 4.2 (Build Build 178 01/19/2005)
-- Created on Sun Nov 25 14:56:57 2007

FUNCTION CMD3_DOWN_Link (Link_Data_in, Cavity_Clock, Start_Enable, Sample_Enable, StartLink, OpCodeData[((8) + (0)) - (1)..0], FirstWordData[(16) - (1)..0], Bus_Clock, Reset, DataBus_In[15..0], DataBusStrobe, Select, DirectIn, AddrBus_In[7..0])
	WITH (RefClock)
	RETURNS (Link_Data_out, Link_TxRx, LinkMessage, 
DataBusOut[15..0], 
ERROR, Test1, Test2, Test3, Test4, Test5, Test6, Test7, TestOutBus[15..0], 
PresamplerStorageOut[((RefClock) / (25)) - (1)..0], TimeOutError, Rx_Start_Bit_Found);
