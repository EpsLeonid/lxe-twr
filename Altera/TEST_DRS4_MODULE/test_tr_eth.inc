-- WARNING: Do NOT edit the input and output ports in this file in a text
-- editor if you plan to continue editing the block that represents it in
-- the Block Editor! File corruption is VERY likely to occur.

-- Copyright (C) 1991-2010 Altera Corporation
-- Your use of Altera Corporation's design tools, logic functions 
-- and other software and tools, and its AMPP partner logic 
-- functions, and any output files from any of the foregoing 
-- (including device programming or simulation files), and any 
-- associated documentation or information are expressly subject 
-- to the terms and conditions of the Altera Program License 
-- Subscription Agreement, Altera MegaCore Function License 
-- Agreement, or other applicable license agreement, including, 
-- without limitation, that your use is for the sole purpose of 
-- programming logic devices manufactured by Altera and sold by 
-- Altera or its authorized distributors.  Please refer to the 
-- applicable agreement for further details.


-- Generated by Quartus II Version 9.1 (Build Build 350 03/24/2010)
-- Created on Mon Jan 04 23:10:16 2016

FUNCTION test_tr_eth (reset, TXclk, St_tx_test, Fp[3..0], kop[3..0], dev_number[3..0], data_DACA[15..0], data_DACB[15..0], data_DACC[15..0], data_DACD[15..0], data_DACE[15..0], data_DACF[15..0], data_DACG[15..0], data_DACH[15..0], calibr, pachka, stat_cor, number_n[15..0], number_p[15..0], zap_delay[15..0], COR_DATA[15..0], COR_DATB[15..0], COR_DATC[15..0], COR_DATD[15..0], COR_DATE[15..0], COR_DATF[15..0], COR_DATG[15..0], COR_DATH[15..0])
	RETURNS (t_TXDout[3..0], t_TXena, t_DataField, t_Lenght[15..0], t_couTransmit[15..0], t_FrameCheck, t_EndTrans);
