-- WARNING: Do NOT edit the input and output ports in this file in a text
-- editor if you plan to continue editing the block that represents it in
-- the Block Editor! File corruption is VERY likely to occur.

-- Copyright (C) 1991-2010 Altera Corporation
-- Your use of Altera Corporation's design tools, logic functions 
-- and other software and tools, and its AMPP partner logic 
-- functions, and any output files from any of the foregoing 
-- (including device programming or simulation files), and any 
-- associated documentation or information are expressly subject 
-- to the terms and conditions of the Altera Program License 
-- Subscription Agreement, Altera MegaCore Function License 
-- Agreement, or other applicable license agreement, including, 
-- without limitation, that your use is for the sole purpose of 
-- programming logic devices manufactured by Altera and sold by 
-- Altera or its authorized distributors.  Please refer to the 
-- applicable agreement for further details.


-- Generated by Quartus II Version 9.1 (Build Build 350 03/24/2010)
-- Created on Mon Feb 01 11:10:58 2016

FUNCTION trans_eth (p_n[1..0], reset, TXclk, start_reply, Saddr[47..0], Daddr[47..0], Rkop[3..0], Rdev_number[3..0], Rstat_cor, Rpachka, Rcalibr, Rnumber_n[15..0], Rnumber_p[15..0], Rzap_delay[15..0], rg_DACA[15..0], rg_DACB[15..0], rg_DACC[15..0], rg_DACD[15..0], rg_DACE[15..0], rg_DACF[15..0], rg_DACG[15..0], rg_DACH[15..0], foto_DACA[15..0], foto_DACB[15..0], foto_DACC[15..0], foto_DACD[15..0], foto_DACE[15..0], foto_DACF[15..0], foto_DACG[15..0], foto_DACH[15..0], rg_DAC_BIAS[15..0], rg_DAC_ROFS[15..0], send_md[7..0])
	RETURNS (TXD[3..0], TXEN, EndTrans, DestinationAddr, SourceAddr, PacketLenth, DataField, couTransmit[15..0], en_read_dm, en_read_slow, en_read_adr);
