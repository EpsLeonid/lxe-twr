-- WARNING: Do NOT edit the input and output ports in this file in a text
-- editor if you plan to continue editing the block that represents it in
-- the Block Editor! File corruption is VERY likely to occur.

-- Copyright (C) 1991-2010 Altera Corporation
-- Your use of Altera Corporation's design tools, logic functions 
-- and other software and tools, and its AMPP partner logic 
-- functions, and any output files from any of the foregoing 
-- (including device programming or simulation files), and any 
-- associated documentation or information are expressly subject 
-- to the terms and conditions of the Altera Program License 
-- Subscription Agreement, Altera MegaCore Function License 
-- Agreement, or other applicable license agreement, including, 
-- without limitation, that your use is for the sole purpose of 
-- programming logic devices manufactured by Altera and sold by 
-- Altera or its authorized distributors.  Please refer to the 
-- applicable agreement for further details.


-- Generated by Quartus II 64-Bit Version 9.1 (Build Build 350 03/24/2010)
-- Created on Thu Jan 28 12:57:47 2021

FUNCTION Digitizer_TA6 (DigitInit, RegInit, ADC_Clock, Bus_Clock, Reset, ADCdata[11..0], DataBus_In[15..0], LinkMessage, WriteRAM, Select, DirectIn, AddrBus_In[9..0], DataBusStrobe, Flink_clock, ReadWFhist, WriteWFhist, DAQAddrBus_In[8..0], ReadWFhist_Eth, WriteWFhist_Eth, DAQAddrBus_Eth_In[8..0])
	WITH (WIDTH_BYTEENA_A, WIDTH_BYTEENA_B)
	RETURNS (DataBusOut[15..0], Working, EventFound, Error, DAQDataBusOut[11..0], CalcPed[13..0], WriteWFEnd, DAQDataBusOut_Eth[11..0], Sample[13..0], Summ[13..0], Subtr[13..0], Zero[13..0], test1, test2, test3, test4[14..0], test5, test6[13..0], test7[13..0], test8[9..0]);
