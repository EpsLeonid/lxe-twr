-- WARNING: Do NOT edit the input and output ports in this file in a text
-- editor if you plan to continue editing the block that represents it in
-- the Block Editor! File corruption is VERY likely to occur.

-- Copyright (C) 1991-2010 Altera Corporation
-- Your use of Altera Corporation's design tools, logic functions 
-- and other software and tools, and its AMPP partner logic 
-- functions, and any output files from any of the foregoing 
-- (including device programming or simulation files), and any 
-- associated documentation or information are expressly subject 
-- to the terms and conditions of the Altera Program License 
-- Subscription Agreement, Altera MegaCore Function License 
-- Agreement, or other applicable license agreement, including, 
-- without limitation, that your use is for the sole purpose of 
-- programming logic devices manufactured by Altera and sold by 
-- Altera or its authorized distributors.  Please refer to the 
-- applicable agreement for further details.


-- Generated by Quartus II 64-Bit Version 9.1 (Build Build 350 03/24/2010)
-- Created on Thu Feb 04 18:26:52 2016

FUNCTION CAMAC (W[16..1], B, N, S1, S2, A[4..1], F[5..1], clock, Confirm, LamSet, LamReset, AccessGranted, DataBusStrobe, DataBusIn[(16) - (1)..0], LinkClockCaptured, LinkActive, LinkError, DeadTime, StatusR_d[15..8])
	WITH (RefClock, DescriptorWord1, DescriptorWord2)
	RETURNS (R[16..1], oX, oQ, oL, CAMAC_Active, Aout[4..1], Start, Reset, AccessRequest, RdWr, AddrBusOut[(16) - (1)..0], DataBusOut[(16) - (1)..0], R_OE, W_OE, ERROR, StatusRW_q[15..0], test[4..1]);
