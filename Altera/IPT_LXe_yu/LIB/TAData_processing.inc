-- WARNING: Do NOT edit the input and output ports in this file in a text
-- editor if you plan to continue editing the block that represents it in
-- the Block Editor! File corruption is VERY likely to occur.

-- Copyright (C) 1991-2010 Altera Corporation
-- Your use of Altera Corporation's design tools, logic functions 
-- and other software and tools, and its AMPP partner logic 
-- functions, and any output files from any of the foregoing 
-- (including device programming or simulation files), and any 
-- associated documentation or information are expressly subject 
-- to the terms and conditions of the Altera Program License 
-- Subscription Agreement, Altera MegaCore Function License 
-- Agreement, or other applicable license agreement, including, 
-- without limitation, that your use is for the sole purpose of 
-- programming logic devices manufactured by Altera and sold by 
-- Altera or its authorized distributors.  Please refer to the 
-- applicable agreement for further details.


-- Generated by Quartus II 64-Bit Version 9.1 (Build Build 350 03/24/2010)
-- Created on Mon Apr 03 15:17:24 2017

FUNCTION TAData_processing (DAQAddrBus_In, TAdata[11..0], WFDataMes, LnkMess, EtherMess, DigitInit, RegInit, clock, Reset, DataBus_In[15..0], WriteRAM, Select, DirectIn, AddrBus_In[9..0], DataBusStrobe)
	RETURNS (WFTAdata[9..0], Data_ready, DataBusOut[15..0], Working, Error, test[9..0]);
