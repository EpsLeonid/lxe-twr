-- WARNING: Do NOT edit the input and output ports in this file in a text
-- editor if you plan to continue editing the block that represents it in
-- the Block Editor! File corruption is VERY likely to occur.

-- Copyright (C) 1991-2008 Altera Corporation
-- Your use of Altera Corporation's design tools, logic functions 
-- and other software and tools, and its AMPP partner logic 
-- functions, and any output files from any of the foregoing 
-- (including device programming or simulation files), and any 
-- associated documentation or information are expressly subject 
-- to the terms and conditions of the Altera Program License 
-- Subscription Agreement, Altera MegaCore Function License 
-- Agreement, or other applicable license agreement, including, 
-- without limitation, that your use is for the sole purpose of 
-- programming logic devices manufactured by Altera and sold by 
-- Altera or its authorized distributors.  Please refer to the 
-- applicable agreement for further details.


-- Generated by Quartus II Version 8.1 (Build Build 163 10/28/2008)
-- Created on Mon Nov 08 17:40:44 2010

FUNCTION ADIS (clock, In_Data[(ADC_Bits) - (1)..0], Reset, Event, LinkMsg, FIR_Control[1..0], Speed_Control, DataBus_In[15..0], DataBusStrobe, Select, DirectIn, AddrBus_In[8..0], SyncPulse)
	WITH (ADC_Bits, NumInReg)
	RETURNS (Start, Amp[(ADC_Bits) - (1)..0], Resolution_Time, DataBusOut[15..0], test1, test2, test3, corr_out[12..0], TimeStampDelay_VP[12..0], LT_Time_VP[12..0], HT_Time_VP[12..0]);
