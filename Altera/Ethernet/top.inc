-- WARNING: Do NOT edit the input and output ports in this file in a text
-- editor if you plan to continue editing the block that represents it in
-- the Block Editor! File corruption is VERY likely to occur.

-- Copyright (C) 1991-2010 Altera Corporation
-- Your use of Altera Corporation's design tools, logic functions 
-- and other software and tools, and its AMPP partner logic 
-- functions, and any output files from any of the foregoing 
-- (including device programming or simulation files), and any 
-- associated documentation or information are expressly subject 
-- to the terms and conditions of the Altera Program License 
-- Subscription Agreement, Altera MegaCore Function License 
-- Agreement, or other applicable license agreement, including, 
-- without limitation, that your use is for the sole purpose of 
-- programming logic devices manufactured by Altera and sold by 
-- Altera or its authorized distributors.  Please refer to the 
-- applicable agreement for further details.


-- Generated by Quartus II 64-Bit Version 9.1 (Build Build 350 03/24/2010)
-- Created on Wed Sep 23 12:32:32 2015

FUNCTION top (CLOCK20MHZ[1..0], STROBE, EthAddrSelect[7..0], ETH_TX_CLK, ETH_RX_CLK, ETH_RX_DV, ETH_RXD[3..0], ETH_CRS, ETH_COL)
	RETURNS (ETH_TX_EN, ETH_TXD[3..0]);
