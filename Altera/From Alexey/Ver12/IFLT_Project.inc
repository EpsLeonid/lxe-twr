-- WARNING: Do NOT edit the input and output ports in this file in a text
-- editor if you plan to continue editing the block that represents it in
-- the Block Editor! File corruption is VERY likely to occur.

-- Copyright (C) 1991-2008 Altera Corporation
-- Your use of Altera Corporation's design tools, logic functions 
-- and other software and tools, and its AMPP partner logic 
-- functions, and any output files from any of the foregoing 
-- (including device programming or simulation files), and any 
-- associated documentation or information are expressly subject 
-- to the terms and conditions of the Altera Program License 
-- Subscription Agreement, Altera MegaCore Function License 
-- Agreement, or other applicable license agreement, including, 
-- without limitation, that your use is for the sole purpose of 
-- programming logic devices manufactured by Altera and sold by 
-- Altera or its authorized distributors.  Please refer to the 
-- applicable agreement for further details.


-- Generated by Quartus II Version 8.1 (Build Build 163 10/28/2008)
-- Created on Fri Jul 09 13:39:56 2010

FUNCTION IFLT_Project (FLCLK, Phase0, PLL_Input, CAMAC_W[24..1], CAMAC_RI[8..1], CAMAC_A[4..1], CAMAC_F[4..0], CAMAC_N, CAMAC_B, CAMAC_S1, CAMAC_S2, CAMAC_Z, CAMAC_C, CAMAC_I, DsrStrob, DsrData[9..0], Lock, R_Lock, W_Lock, POSS_Dummy_In)
	RETURNS (Link_TxRx, Link_Data, Wire_Data, Phase25, Phase0Direct, LedR, LedG, LedB, CAMAC_R[16..1], CAMAC_Q, CAMAC_X, CAMAC_L, SerDataOutR[7..0], SerDataOutW[7..0], NWordR[1..0], NWordW[1..0], W_Sync, R_Sync, PWRDN, W_En1, R_En1, W_En2, R_En2, 3PH_CLK0, TrgResult0, TrgResult1, pin5, pin6, pin7, FOR_Shaped[47..0], DeadTime[5..0], resultTrig[5..0], RAM_Addr_Cnt[7..0], RAM_Addr_Clk_en, F_Sample_Enable, CLK37_5_Virtual_Pin, Event_ES_Beg_Virtual_Pin, Address_Line_Virtual_Pin[15..0], Data_Line_Virtual_Pin[15..0], Data_Bus_Strobe_VP, Target_Ready_VP, Address_Valid_VP);
