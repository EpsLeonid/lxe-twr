-- WARNING: Do NOT edit the input and output ports in this file in a text
-- editor if you plan to continue editing the block that represents it in
-- the Block Editor! File corruption is VERY likely to occur.

-- Copyright (C) 1991-2005 Altera Corporation
-- Any  megafunction  design,  and related netlist (encrypted  or  decrypted),
-- support information,  device programming or simulation file,  and any other
-- associated  documentation or information  provided by  Altera  or a partner
-- under  Altera's   Megafunction   Partnership   Program  may  be  used  only
-- to program  PLD  devices (but not masked  PLD  devices) from  Altera.   Any
-- other  use  of such  megafunction  design,  netlist,  support  information,
-- device programming or simulation file,  or any other  related documentation
-- or information  is prohibited  for  any  other purpose,  including, but not
-- limited to  modification,  reverse engineering,  de-compiling, or use  with
-- any other  silicon devices,  unless such use is  explicitly  licensed under
-- a separate agreement with  Altera  or a megafunction partner.  Title to the
-- intellectual property,  including patents,  copyrights,  trademarks,  trade
-- secrets,  or maskworks,  embodied in any such megafunction design, netlist,
-- support  information,  device programming or simulation file,  or any other
-- related documentation or information provided by  Altera  or a megafunction
-- partner, remains with Altera, the megafunction partner, or their respective
-- licensors. No other licenses, including any licenses needed under any third
-- party's intellectual property, are provided herein.


-- Generated by Quartus II Version 4.2 (Build Build 178 01/19/2005)
-- Created on Fri Apr 06 17:36:41 2007

FUNCTION CAMAC (W[16..1], B, N, A[4..1], F[4..0], S1, S2, clock, LamReset, AccessGranted, DataBusStrobe, DataBusIn[(16) - (1)..0], LinkClockCaptured, LinkActive, Link_Error, Busy_on_Digitizing, Busy_on_Copy, DeadTime)
	WITH (RefClock)
	RETURNS (R[16..1], q, X1, LAM, AccessRequest, Direct, AddrBusOut[(16) - (1)..0], Addr_MemnReg, DataBusOut[(16) - (1)..0], Start, Reset, CAMAC_Error, test1, test2, test3, LAMTrg);
